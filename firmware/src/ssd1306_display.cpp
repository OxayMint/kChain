#include "ssd1306_display.h"

#include <Arduino.h>
#include <Wire.h>

#include <cstring>

#include "config.h"
#include "utf8_text.h"

namespace {

constexpr uint8_t kCommand = 0x00;
constexpr uint8_t kData = 0x40;
// 5 columns plus a 1-pixel gap. text() and textWidth both use this.
constexpr int kAdvance = 6;

// 5x7, bit 0 is the top row. ASCII 0x20 through 0x7E.
constexpr uint8_t kFont[][5] = {
    {0x00, 0x00, 0x00, 0x00, 0x00}, {0x00, 0x00, 0x5F, 0x00, 0x00}, {0x00, 0x07, 0x00, 0x07, 0x00},
    {0x14, 0x7F, 0x14, 0x7F, 0x14}, {0x24, 0x2A, 0x7F, 0x2A, 0x12}, {0x23, 0x13, 0x08, 0x64, 0x62},
    {0x36, 0x49, 0x55, 0x22, 0x50}, {0x00, 0x05, 0x03, 0x00, 0x00}, {0x00, 0x1C, 0x22, 0x41, 0x00},
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    {0x00, 0x41, 0x36, 0x08, 0x00}, {0x08, 0x04, 0x08, 0x10, 0x08},
};

static_assert(sizeof(kFont) / sizeof(kFont[0]) == 95, "font covers ASCII 0x20 through 0x7E");

const uint8_t* columnsFor(uint32_t codepoint) {
  if (codepoint < 0x20 || codepoint > 0x7E) codepoint = '?';
  return kFont[codepoint - 0x20];
}

bool writeBytes(uint8_t address, uint8_t control, const uint8_t* bytes, size_t length) {
  Wire.beginTransmission(address);
  if (Wire.write(control) != 1) return false;
  if (length > 0 && Wire.write(bytes, length) != length) return false;
  return Wire.endTransmission() == 0;
}

}  // namespace

bool Ssd1306Display::command(uint8_t value) { return writeBytes(kAddress, kCommand, &value, 1); }

bool Ssd1306Display::command2(uint8_t value, uint8_t arg) {
  const uint8_t bytes[] = {value, arg};
  return writeBytes(kAddress, kCommand, bytes, 2);
}

bool Ssd1306Display::begin() {
  ready_ = false;
  // The charge pump needs a moment after 3.3 V is applied.
  delay(100);
  Wire.begin(PIN_OLED_SDA, PIN_OLED_SCL);
  // 400 kHz keeps a full frame shorter than the send step, so each
  // character of the exit is actually drawn.
  Wire.setClock(400000);
  Wire.setTimeOut(50);

  Wire.beginTransmission(kAddress);
  if (Wire.endTransmission() != 0) return false;

  // 128x32, charge pump on. A 64-row multiplex, or the pump left off, keeps
  // this glass dark after a good address ACK.
  const bool ok = command(0xAE) && command2(0xD5, 0x80) && command2(0xA8, 0x1F) && command2(0xD3, 0x00) &&
                  command(0x40) && command2(0x8D, 0x14) && command2(0x20, 0x00) && command(0xA1) &&
                  command(0xC8) && command2(0xDA, 0x02) && command2(0x81, 0x8F) && command2(0xD9, 0xF1) &&
                  command2(0xDB, 0x40) && command(0xA4) && command(0xA6) && command(0x2E) && command(0xAF);
  if (!ok) return false;
  ready_ = true;
  clear();
  flush();
  return true;
}

void Ssd1306Display::clear() {
  if (!ready_) return;
  memset(frame_, 0, sizeof(frame_));
}

void Ssd1306Display::pixel(int x, int y, bool on) {
  if (x < 0 || y < 0 || x >= kWidth || y >= kHeight) return;
  if (clipBottom_ > clipTop_ && (y < clipTop_ || y >= clipBottom_)) return;
  const uint8_t mask = static_cast<uint8_t>(1u << (y % 8));
  uint8_t& cell = frame_[(y / 8) * kWidth + x];
  if (on) cell |= mask;
  else cell &= static_cast<uint8_t>(~mask);
}

void Ssd1306Display::glyph(int x, int y, uint32_t codepoint, bool ink) {
  const uint8_t* columns = columnsFor(codepoint);
  for (int column = 0; column < 5; column++) {
    uint8_t columnBits = columns[column];
    for (int row = 0; row < kTextHeight; row++) {
      if ((columnBits & 1u) != 0) pixel(x + column, y + row, ink);
      columnBits >>= 1;
    }
  }
}

void Ssd1306Display::fillRect(int x, int y, int w, int h) {
  if (!ready_ || w <= 0 || h <= 0) return;
  for (int row = 0; row < h; row++) {
    for (int column = 0; column < w; column++) pixel(x + column, y + row, true);
  }
}

void Ssd1306Display::text(int x, int y, const char* text, bool ink) {
  if (!ready_ || text == nullptr) return;
  while (text[0] != '\0') {
    uint32_t codepoint = 0;
    text += nextCodepoint(text, codepoint);
    if (x >= kWidth) return;
    if (x + 5 > 0) glyph(x, y, codepoint, ink);
    x += kAdvance;
  }
}

void Ssd1306Display::bits(int x, int y, const uint8_t* columns, int columnCount, int rows, bool ink) {
  if (!ready_ || columns == nullptr || columnCount <= 0 || rows <= 0) return;
  for (int column = 0; column < columnCount; column++) {
    uint8_t columnBits = columns[column];
    for (int row = 0; row < rows; row++) {
      if ((columnBits & 1u) != 0) pixel(x + column, y + row, ink);
      columnBits >>= 1;
    }
  }
}

int Ssd1306Display::textWidth(const char* text) const {
  if (text == nullptr || text[0] == '\0') return 0;
  return countCodepoints(text) * kAdvance;
}

int Ssd1306Display::letterGap(int height) const {
  if (height <= 0) return 0;
  const int gap = height / kTextHeight;
  return gap < 1 ? 1 : gap;
}

int Ssd1306Display::glyphWidthBox(int height) const {
  if (height <= 0) return 0;
  const int width = (5 * height) / kTextHeight;
  return width < 1 ? 1 : width;
}

int Ssd1306Display::textWidthBox(const char* text, int height) const {
  if (text == nullptr || text[0] == '\0' || height <= 0) return 0;
  const int count = countCodepoints(text);
  if (count <= 0) return 0;
  return count * glyphWidthBox(height) + (count - 1) * letterGap(height);
}

void Ssd1306Display::blit(int x, int y, const uint8_t* columns, int srcCols, int srcRows, int dstW, int dstH,
                          bool ink) {
  if (!ready_ || columns == nullptr || srcCols <= 0 || srcRows <= 0 || dstW <= 0 || dstH <= 0) return;
  if (x >= kWidth || y >= kHeight || x + dstW <= 0 || y + dstH <= 0) return;
  for (int dy = 0; dy < dstH; dy++) {
    const int sy = dy * srcRows / dstH;
    if (sy < 0 || sy >= srcRows || sy >= 8) continue;
    for (int dx = 0; dx < dstW; dx++) {
      const int sx = dx * srcCols / dstW;
      if (sx < 0 || sx >= srcCols) continue;
      if ((columns[sx] & (1u << sy)) != 0) pixel(x + dx, y + dy, ink);
    }
  }
}

void Ssd1306Display::textBox(int x, int y, const char* text, int height, bool ink) {
  if (!ready_ || text == nullptr || height <= 0) return;
  const int glyphW = glyphWidthBox(height);
  const int gap = letterGap(height);
  while (text[0] != '\0') {
    uint32_t codepoint = 0;
    text += nextCodepoint(text, codepoint);
    if (x >= kWidth) return;
    if (x + glyphW > 0) blit(x, y, columnsFor(codepoint), 5, kTextHeight, glyphW, height, ink);
    x += glyphW + gap;
  }
}

void Ssd1306Display::bitsBox(int x, int y, const uint8_t* columns, int columnCount, int rows, int height, bool ink) {
  if (columnCount <= 0 || rows <= 0 || height <= 0) return;
  int dstW = columnCount * height / rows;
  if (dstW < 1) dstW = 1;
  blit(x, y, columns, columnCount, rows, dstW, height, ink);
}

void Ssd1306Display::flush() {
  if (!ready_) return;
  const uint8_t window[] = {0x21, 0x00, static_cast<uint8_t>(kWidth - 1), 0x22, 0x00,
                            static_cast<uint8_t>(kPages - 1)};
  if (!writeBytes(kAddress, kCommand, window, sizeof(window))) return;
  for (size_t offset = 0; offset < sizeof(frame_); offset += 16) {
    if (!writeBytes(kAddress, kData, frame_ + offset, 16)) return;
  }
}
